/dts-v1/;
/plugin/;

/ {
    compatible = "ti,beaglebone", "ti,beaglebone-black";
    part-number = "BB-PRU0-CAN-TS";
    version = "00A0";

    exclusive-use = "pruss";

    /*
     * Delete the base DTB pinctrl from the PRUSS node so the PRUSS driver
     * probes cleanly.  P8.46 is configured as a GPIO interrupt at runtime
     * by setup_pru.sh; it does not need a PRUSS pinctrl entry.
     */
    fragment@0 {
        target = <&pruss>;
        __overlay__ {
            /delete-property/ pinctrl-names;
            /delete-property/ pinctrl-0;
        };
    };

    /*
     * Reserve 8 KB of DDR at 0x9F000000 for the PRU ring buffer.
     * No "no-map": allows normal ARM /dev/mem mmap (read+write).
     */
    fragment@1 {
        target-path = "/";
        __overlay__ {
            reserved-memory {
                #address-cells = <1>;
                #size-cells = <1>;
                ranges;

                pru_shm: pru_shm@9f000000 {
                    reg = <0x9f000000 0x2000>;
                };
            };
        };
    };
};
