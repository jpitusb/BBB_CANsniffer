/dts-v1/;
/plugin/;

#include <dt-bindings/board/am335x-bbw-bbb-base.h>
#include <dt-bindings/pinctrl/am33xx.h>

/ {
    compatible = "ti,beaglebone", "ti,beaglebone-black";
    part-number = "BB-DCAN0";
    version = "00A0";

    exclusive-use = "P9.24", "P9.26", "dcan0";

    fragment@0 {
        target = <&am33xx_pinmux>;
        __overlay__ {
            bb_dcan0_pins: pinmux_bb_dcan0_pins {
                pinctrl-single,pins = <
                    /* P9.26  ball A14  DCAN0_TX  mode 2  output pull-up */
                    BONE_P9_26 (PIN_OUTPUT_PULLUP | MUX_MODE2)
                    /* P9.24  ball D15  DCAN0_RX  mode 2  input  pull-up */
                    BONE_P9_24 (PIN_INPUT_PULLUP  | MUX_MODE2)
                >;
            };
        };
    };

    fragment@1 {
        target = <&dcan0>;
        __overlay__ {
            status = "okay";
            pinctrl-names = "default";
            pinctrl-0 = <&bb_dcan0_pins>;
        };
    };
};
